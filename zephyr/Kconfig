## zephyr/Kconfig
```kconfig
# Copyright (c) 2020 PHYTEC Messtechnik GmbH
# SPDX-License-Identifier: Apache-2.0

config UC_USBH
	bool "uC USB Host support"

config UC_USBH_MSC
	bool "USB MSC Class Support"

config UC_USBH_CDC
	bool "USB MSC Class Support"
```
